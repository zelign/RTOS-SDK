## Kconfig
```kconfig
mainmenu "Main Menu"

menu "Architecture Options"
source "arch/Kconfig"
endmenu

menu "Boards Options"
source "boards/Kconfig"
endmenu

menu "Driver Selection"
source "drivers/Kconfig"
endmenu

menu "Kernel Selection"
source "kernel/Kconfig"
endmenu

menu "Libraries Selection"
source "lib/Kconfig"
endmenu

menu "Compile Options"
config CPU
    string
    default "-mcpu=cortex-m4" if Cortex_M4
    default "-mcpu=cortex-m3" if Cortex_M3
config FPU
    string
    default "-mfpu=fpv4-sp-d16" if Cortex_M4

config FLOAT_ABI
    string
    default "-mfloat-abi=hard" if Cortex_M4
config INSTRCTION_SET
    string
    default "-mthumb" if Cortex_M4 || Cortex_M3
config VERBOSE
    bool "Verbose build output"
    default n
choice
    prompt "Whether use standard libraries"
    default NO_STD_LIBS

config USE_STD_LIBS
    bool "YES"

config NO_STD_LIBS
    bool "No"

endchoice

choice
    prompt "Selet optimization level"
    default OPTIMIZATION_O2
config OPTIMIZATION_O0
    bool "-O0"
config OPTIMIZATION_O1
    bool "-O1"
config OPTIMIZATION_O2
    bool "-O2"
config OPTIMIZATION_O3
    bool "-O3"
config OPTIMIZATION_Os
    bool "-Os"
config OPTIMIZATION_Ofast
    bool "-Ofast"
config OPTIMIZATION_Og
    bool "-Og"
endchoice

config STD_LIBS
    string
    default "-nostdlib" if NO_STD_LIBS
config OPTIMIZATION_PEVEL
    string
    default "-O0" if OPTIMIZATION_O0
    default "-O1" if OPTIMIZATION_O1
    default "-O2" if OPTIMIZATION_O2
    default "-O3" if OPTIMIZATION_O3
    default "-Os" if OPTIMIZATION_Os
    default "-Ofast" if OPTIMIZATION_Ofast
    default "-Og" if OPTIMIZATION_Og
endmenu
```

## arch/Kconfig
```kconfig
choice
    prompt "Select Architecture"
    default ARM32

config ARM32
    bool "ARM (32-bit architecture)"

if ARM32
choice
    prompt "Select ARM Core"
    default Cortex_M4

config Cortex_M4
    bool "ARM cortex-M4 Core"

config Cortex_M3
    bool "ARM cortex-M3 Core"
config Cortex_A7
    bool "ARM cortex-A7 Core"
endchoice

config CHIP_ARCH
	string
    default "Cortex-M3" if Cortex_M3
    default "Cortex-M4" if Cortex_M4
	help
	  Select the ARM Core architecture.

endif

config ARM64
    bool "ARM64 (64-bit architecture)"

if ARM64
choice
    prompt "Select ARM64 Core"
    default Cortex_A75

config Cortex_A75
    bool "ARM cortex-A75 Core"

config Cortex_A35
    bool "ARM cortex-A35 Core"
endchoice

config CHIP_ARCH
	string
    default "Cortex-A35" if Cortex_A35
    default "Cortex-A75" if Cortex_A75
	help
	  Select the ARM64 Core architecture.
endif

config MCS_51
    bool "MCS-51 series"

if MCS_51
choice
    prompt "Select MCS-51 Core"
    default C_8051

config C_8051
    bool "MCS-51 series Core"
endchoice

config CHIP_ARCH
	string
    default "8051" if C_8051
	help
	  Select the MCS-51 series Core architecture.
endif

endchoice
```

## arch/arm/Kconfig
```kconfig
menu "ARM32 chip configuration"
choice
    prompt "Select ARM Core"
    default CORTEX_M4

config CORTEX_M4
    bool "ARM cortex-M4 Core"

config CORTEX_M3
    bool "ARM cortex-M3 Core"
endchoice

config CHIP_CORE
	string "Select the ARM Core"
    default "Cortex-M3" if CORTEX_M3
    default "Cortex-M4" if CORTEX_M4
	help
	  Select the ARM Core architecture.
endmenu
```

## boards/Kconfig
```kconfig
#define the first choice enter
choice
	prompt "Select a board"

#if define CONFIG_ARM32 then select the boards that architecture is arm32
if ARM32
config STM32
	bool "The Stm32 series boards"
    depends on Cortex_M3 || Cortex_M4
#if the boards is stm32 series
if STM32
if Cortex_M3
choice
	prompt "Stm32 Cortex-M3 series boards"

config F103_ZET6
	bool "Stm32F103ZET6 support"
config F103_ZGT6
	bool "Stm32F103ZGT6 support"
endchoice #"Stm32 Cortex-M3 series boards"

config BOARD_VERSION
	string
    default "f103zet6" if F103_ZET6
    default "f103zgt6" if F103_ZGT6
	help
	  The STmicro series boards support

endif #endif Cortex_M3


if Cortex_M4
choice
	prompt "Stm32 Cortex-M4 series boards"

config F407_ZET6
	bool "Stm32F407ZET6 support"
config F407_ZGT6
	bool "Stm32F407ZGT6 support"
endchoice #"Stm32 Cortex-M4 series boards"

config BOARD_VERSION
	string
	default "f407zgt6" if F407_ZGT6
    default "f407zet6" if F407_ZET6
	help
	  The STmicro series boards support
endif #Cortex_M4


config BOARD_NAME
	string
    default "stm32" if STM32
	help
	  Board name
endif #endif STM32


config NXP
    bool "The NXP series boards"
    depends on Cortex_A7

if NXP
if Cortex_A7
#select nxp series boards
choice
    prompt "NXP series boards"

config IMX6ULL
    bool "I.MX6ULL board support"
endchoice #"NXP series boards"

config BOARD_VERSION
	string
	default "imx6ull" if IMX6ULL
	help
	  The NXP series boards support
endif #endif Cortex_A7


config BOARD_NAME
	string
    default "nxp" if NXP
	help
	  Board name
endif #endif NXP


endif #endif ARM32


if MCS_51
config STC
    bool "The STC series boards"
    depends on MCS_51

if STC
choice
    prompt "STC series boards"
config STC_89C51
    bool "The Stc 89c51 suppport"
config STC_89C52
    bool "The Stc 89c52 suppport"
config STC_89C51RC
    bool "The Stc 89c51rc suppport"
config STC_89C52RC
    bool "The Stc 89c52rc suppport"

endchoice

config BOARD_VERSION
	string
	default "89c51" if STC_89C51
    default "89c52" if STC_89C52
    default "89c51rc" if STC_89C51RC
    default "89c52rc" if STC_89C52RC
	help
	  The STC series boards support
config BOARD_NAME
	string
    default "stc" if STC
	help
	  Board name

endif #endif STC
endif #endif MCS_51

endchoice
```

## drivers/Kconfig
```kconfig
rsource "flash/Kconfig"
config CLOCK
    bool "clock support"
    default y
config GPIO
    bool "gpio support"
    default y
config LED
    bool "led support"
    default y
config KEY
    bool "key support"
    default y
config USART
    bool "USART support"
    default y
if USART

choice
    prompt "Choose trigger mode"
    default USART_LOOP_TRIGGER
config USART_LOOP_TRIGGER
    bool "loop trigger"
config USART_IRQ_TRIGGER
    bool "irq trigger"
endchoice
endif

config SPI
    bool "SPI support"
    default y
```

## drivers/flash/Kconfig
```kconfig
choice
    prompt "Flash devices"
config NOR_FLASH
    bool "NOR Flash"
if NOR_FLASH
choice
    prompt "Nor Flash devices"
config BY25Q64AS
    bool "BY25Q64AS support"
endchoice
endif


config NAND_FLASH
    bool "Nand Flash"
if NAND_FLASH
choice
    prompt "Nand Flash devices"
config TC58NVG0S3HTA00
    bool "TC58NVG0S3HTA00 support"
endchoice
endif


endchoice
```

## kernel/Kconfig
```kconfig
choice
    prompt "Kernel Selection"
config FREERTOS
    bool "FreeRTOS support"

config UCOSII
    bool "ucos-ii support"

config UCOSIII
    bool "ucos-iii support"

config RT_THREAD
    bool "rt-thread support"


endchoice

if FREERTOS
config FREERTOS_PORT
    string
    default "ARM_CM4F" if Cortex_M4
endif

config KERNEL
    string
    default "FreeRTOS" if FREERTOS
    default "ucosii" if UCOSII
    default "ucosii" if UCOSIII
    default "RT-Thread" if RT_THREAD
    help
      "Kernel name"
```

## lib/Kconfig
```kconfig
config CLI_LIB
    bool "Command line support"
    default y

if CLI_LIB

choice
    prompt "Cli Selection"
    default FREERTOS_CLI
config FREERTOS_CLI
    bool "FreeRTOS provide cli"
config LINUX_CLI
    bool "Linux support cli"
endchoice
config CLI
    string
    default "FreeRTOS_CLI" if FREERTOS_CLI
    default "Linux_CLI" if LINUX_CLI
    help
      CLI name
endif

config SIM_LIBC
    bool "Simon provided libc"
    default y
config FLASH_CMD
    bool "flash command support"
    default y

config FS
    bool "File System support"
if FS
choice
    prompt "Select a file system"
config FAT
    bool "Fat filesystem format"
if FAT
choice
    prompt "Select a Fat filesysten"
config FILEX
    bool "FileX system"
if FILEX
    config SECTOR_SIZE
        int "media bytes of sector size"
        default 256
        range 256 1024
endif

endchoice
endif
config EXT
    bool "Ext filesystem format"
endchoice
endif

config NANO_PRINTF
    bool "Nano printf support"
    default n

config USB_LIB
    bool "USB support"
    default y

if USB_LIB

choice
    prompt "USB Libraries Selection"
    default STM32_USB_LIB

config STM32_USB_LIB
    bool "STMicro USB library"
config Cherry_USB_LIB
    bool "Cherry USB library"
endchoice
config USB
    string
    default STM32_USB if STM32_USB_LIB
    default "Cheery_USB" if Cherry_USB_LIB
    help
      USB lib name
endif
```
